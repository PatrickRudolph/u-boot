## arch/arm/mach-aspeed/ast2500/Kconfig
```kconfig
if ASPEED_AST2500

config SYS_CPU
	default "arm1176"

choice
	prompt "AST2500 target select"
	depends on ASPEED_AST2500
	default TARGET_EVB_AST2500

config TARGET_EVB_AST2500
	bool "EVB-AST2500"
	help
	  Evb-AST2500 is Aspeed evaluation board for AST2500 chip.
	  It has 512M of RAM, 32M of SPI flash, two Ethernet ports,
	  4 Serial ports, 4 USB ports, VGA port, PCIe, SD card slot,
	  20 pin JTAG, pinouts for 14 I2Cs, 3 SPIs and eSPI, 8 PWMs.
endchoice

config DRAM_UART_TO_UART1
	bool
	prompt "Route debug UART to UART1"
	help
	  Route debug UART to TXD1/RXD1 pins.

config FIRMWARE_2ND_BOOT
	bool
	default y
	prompt "Keep WDT2 running to support the firmware 2nd boot"
	help
	  Saying yes here let the WDT2 running (if configured by
	  hw straps) and allows the platform to boot from 2nd
	  SPI flash if WDT2 isn't poked withing 22 seconds.
	  Saying no disables the WDT2 in early platform initialisation.

source "board/aspeed/evb_ast2500/Kconfig"

endif
```

## board/ibm/genesis3/Kconfig
```kconfig
if TARGET_IBM_GENESIS3

config SYS_BOARD
	default "genesis3"

config SYS_VENDOR
	default "ibm"

config SYS_CONFIG_NAME
	string "board configuration name"
	default "ibm_genesis3"

endif
```
